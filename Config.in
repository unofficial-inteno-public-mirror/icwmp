## Config.in
```kconfig
if PACKAGE_cwmp-curl || PACKAGE_cwmp-zstream

config CWMP_SCRIPTS_FULL
	bool "Install all cwmp scripts"
	default y

choice
	prompt "Select ACS sever"
	default CWMP_ACS_MULTI

config CWMP_ACS_MULTI
	bool "No specific ACS, follow standard"

config CWMP_ACS_HDM
	bool "HDM"
endchoice

config CWMP_DEBUG
	bool "Compile with debug options"
	default y

config CWMP_DEVEL_DEBUG
	bool "Compile with development debug options"
	default n

endif
```
